## arch/arm64/Kconfig
```kconfig
config LITTLE_ENDIAN
        def_bool y

config PAGE_SIZE
        int
        default 4096

config ARM64
	bool
	default y
	select ARCH_HAS_ATOMIC64_DEC_IF_POSITIVE
	select ARCH_HAS_ELF_RANDOMIZE
	select ARCH_HAS_GCOV_PROFILE_ALL
	select ARCH_SUPPORTS_ATOMIC_RMW
	select ARCH_USE_BUILTIN_BSWAP
	select ARCH_USE_CMPXCHG_LOCKREF
	select HAVE_EFFICIENT_UNALIGNED_ACCESS
	select HAVE_CC_STACKPROTECTOR
	select GENERIC_HWEIGHT
	select GENERIC_CALIBRATE_DELAY
	select SWIOTLB
	help
	  AArch64 (64-bit ARM) architecture support.

config 64BIT
	def_bool y

config ARCH_PHYS_ADDR_T_64BIT
	def_bool y

config GENERIC_HWEIGHT
	bool
	default y

config GENERIC_CALIBRATE_DELAY
	bool
	default y

config SWIOTLB
	def_bool y

config HAVE_SMP
	bool
	default y

config SMP
	bool "Symmetric Multi-Processing"
	depends on HAVE_SMP
	default y
	help
	  This enables support for systems with more than one CPU.

config NR_CPUS
	int "Maximum number of CPUs (2-4096)"
	range 2 4096
	depends on SMP
	default "8"

# CPU native detection. When enabled, the build host is probed by the cpucap
# tool (built and exported as HOST_ARM_MODEL by the top-level Makefile) and the
# matching entry in the "ARM CPU" choice below is selected automatically,
# pulling in that core's predefined capabilities. When disabled, the CPU is
# chosen manually.
config CPU_NATIVE
	bool "Optimize for the build host CPU (native detection)"
	help
	  Detect the CPU this build is running on and automatically select the
	  closest matching ARM CPU below, so its predefined cryptographic
	  extensions (AES/PMULL/SHA-2, SHA-3, ...) are enabled without picking a
	  core by hand. The compiler is also pointed at the exact host CPU
	  (-mcpu=native, falling back to generic if it is not understood).

	  The resulting binary is tuned for and requires a CPU at least as
	  capable as the build host, so it is not portable to older cores. Turn
	  this off to choose a specific ARM CPU (or Generic) manually.

	  If unsure, say N.

# Host-detected ARM core, emitted by `scripts/cpucap --env` and exported by
# kbuild's top-level Makefile. Selects the matching choice entry when
# CPU_NATIVE is set.
config HOST_ARM_MODEL
	string
	option env="HOST_ARM_MODEL"

choice
	prompt "ARM CPU"
	default ARM_CPU_APPLE_M4    if CPU_NATIVE && HOST_ARM_MODEL = "ARM_CPU_APPLE_M4"
	default ARM_CPU_APPLE_M1    if CPU_NATIVE && HOST_ARM_MODEL = "ARM_CPU_APPLE_M1"
	default ARM_CPU_NEOVERSE_V1 if CPU_NATIVE && HOST_ARM_MODEL = "ARM_CPU_NEOVERSE_V1"
	default ARM_CPU_CORTEX_A72  if CPU_NATIVE && HOST_ARM_MODEL = "ARM_CPU_CORTEX_A72"
	default ARM_CPU_GENERIC     if CPU_NATIVE
	default ARM_CPU_GENERIC
	help
	  Select the target ARM CPU for optimized code generation.
	  The compiler will use architecture-specific instructions
	  and tuning for the selected CPU.

config ARM_CPU_GENERIC
	bool "Generic ARMv8-A"
	help
	  Generic ARMv8-A target. Compatible with all AArch64 CPUs.

config ARM_CPU_CORTEX_A53
	bool "Cortex-A53 (ARMv8.0-A)"
	help
	  ARM Cortex-A53, low-power in-order core.
	  Used in Raspberry Pi 3, many mobile SoCs.

config ARM_CPU_CORTEX_A55
	bool "Cortex-A55 (ARMv8.2-A)"
	help
	  ARM Cortex-A55, high-efficiency core.
	  Successor to Cortex-A53.

config ARM_CPU_CORTEX_A57
	bool "Cortex-A57 (ARMv8.0-A)"
	help
	  ARM Cortex-A57, high-performance out-of-order core.

config ARM_CPU_CORTEX_A72
	bool "Cortex-A72 (ARMv8.0-A)"
	help
	  ARM Cortex-A72, used in Raspberry Pi 4 and many
	  embedded/networking SoCs.

config ARM_CPU_CORTEX_A76
	bool "Cortex-A76 (ARMv8.2-A)"
	help
	  ARM Cortex-A76, high-performance core.

config ARM_CPU_NEOVERSE_N1
	bool "Neoverse N1 (ARMv8.2-A)"
	help
	  ARM Neoverse N1, server-class core.
	  Used in AWS Graviton2 (M6g, C6g, R6g).

config ARM_CPU_NEOVERSE_V1
	bool "Neoverse V1 (ARMv8.4-A)"
	help
	  ARM Neoverse V1, high-performance server core.
	  Used in AWS Graviton3 (M7g, C7g, R7g).

config ARM_CPU_NEOVERSE_V2
	bool "Neoverse V2 (ARMv9.0-A)"
	help
	  ARM Neoverse V2, next-gen server core.
	  Used in AWS Graviton4 (M8g, C8g, R8g).

config ARM_CPU_CORTEX_A710
	bool "Cortex-A710 (ARMv9.0-A)"
	help
	  ARM Cortex-A710, ARMv9 high-performance core.

config ARM_CPU_CORTEX_X2
	bool "Cortex-X2 (ARMv9.0-A)"
	help
	  ARM Cortex-X2, ARMv9 peak-performance core.

config ARM_CPU_APPLE_M1
	bool "Apple M1 (ARMv8.5-A)"
	help
	  Apple M1, high-performance desktop/laptop core.

config ARM_CPU_APPLE_M4
	bool "Apple M4 (ARMv9.2-A)"
	help
	  Apple M4, high-performance desktop/laptop core with SME and the
	  ARMv8.4 cryptographic + SHA-3 extensions and data-independent timing
	  (DIT). Falls back to an earlier apple-m* / generic tuning if the
	  compiler does not know -mcpu=apple-m4.

config ARM_CPU_APPLE_M5
	bool "Apple M5 (ARMv9.2-A)"
	help
	  Apple M5, latest-generation high-performance desktop/laptop core.
	  Same cryptographic capability tier as the M4 (crypto, SHA-3, DIT);
	  falls back to an earlier apple-m* / generic tuning if the compiler
	  does not know -mcpu=apple-m5.

endchoice

config NEON
	bool "Advanced SIMD (NEON) Extension support"
	default y
	help
	  AArch64 always has Advanced SIMD support.

config ARM_CRYPTO_EXTENSIONS
	bool "ARMv8 Cryptographic Extensions"
	default y if !ARM_CPU_GENERIC && !ARM_CPU_CORTEX_A53 && !ARM_CPU_CORTEX_A57
	help
	  Enable ARMv8 cryptographic instructions (AES, SHA1, SHA2,
	  PMULL). Available on most ARMv8.0-A and later cores.

	  Under CPU_NATIVE the ARM CPU above is auto-selected from the build
	  host, so this follows whatever that detected core provides.

# Host DIT (data-independent timing) support, detected by scripts/cpucap and
# exported as HOST_ARM_HAS_DIT by kbuild's top-level Makefile. Drives ARM_DIT
# under CPU_NATIVE.
config HOST_ARM_HAS_DIT
	string
	option env="HOST_ARM_HAS_DIT"

config ARM_DIT
	bool "Enable DIT for constant-time cryptographic operations"
	default HOST_ARM_HAS_DIT = "y" if CPU_NATIVE
	default y if !ARM_CPU_GENERIC && !ARM_CPU_CORTEX_A53 && !ARM_CPU_CORTEX_A57
	help
	  Certain instructions on ARM64, including but not limited to those
	  described in Arm Architecture Registers for Future Architecture
	  Technologies, may take a different amount of time to run depending on
	  the data values on which they operate. Malicious code running on the
	  device might use this property to infer information about the data the
	  CPU processes, such as cryptographic keys, or other sensitive data.
	  Apple silicon provides data-independent timing (DIT), in which the
	  processor completes certain instructions in a constant amount of time.
	  With DIT enabled, the processor uses the longer, worst-case amount of
	  time to complete the instruction, regardless of the input data. When
	  you write software specifically to avoid leaking internal information
	  and to run code in constant time, enabling DIT — and restricting your
	  code to instructions that support DIT — before loading cryptographic key
	  material, performing cryptographic operations, or processing sensitive
	  data ensures the timing of specific instructions doesn’t reveal
	  information about the data being processed.

config ARM_SHA3_EXTENSIONS
	bool "ARMv8.2 SHA-3 Extensions"
	depends on ARM_CRYPTO_EXTENSIONS
	default y if ARM_CPU_NEOVERSE_N1 || ARM_CPU_NEOVERSE_V1 || \
	             ARM_CPU_NEOVERSE_V2 || ARM_CPU_CORTEX_A76 || \
	             ARM_CPU_CORTEX_A710 || ARM_CPU_CORTEX_X2 || \
	             ARM_CPU_APPLE_M1 || ARM_CPU_APPLE_M4 || ARM_CPU_APPLE_M5
	help
	  Enable ARMv8.2 SHA-3 and SHA-512 instructions.
	  Available on Neoverse and newer Cortex-A cores, and Apple silicon.
```
